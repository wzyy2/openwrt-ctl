#include "oled.h"

const unsigned char F6x8[][6] =		
{
0x00, 0x00, 0x00, 0x00, 0x00, 0x00,// sp
0x00, 0x00, 0x00, 0x2f, 0x00, 0x00,// !
0x00, 0x00, 0x07, 0x00, 0x07, 0x00,// "
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0x14, 0x14, 0x14, 0x14, 0x14, 0x14,// horiz lines
};


const unsigned char  F8X16[]=	  
{
  0x00,0x00,0x00,0x00,0x00,0x00,0x00,0x00,0x00,0x00,0x00,0x00,0x00,0x00,0x00,0x00,// 0
  0x00,0x00,0x00,0xF8,0x00,0x00,0x00,0x00,0x00,0x00,0x00,0x33,0x30,0x00,0x00,0x00,//! 1
  0x00,0x10,0x0C,0x06,0x10,0x0C,0x06,0x00,0x00,0x00,0x00,0x00,0x00,0x00,0x00,0x00,//" 2
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  0x00,0x06,0x01,0x01,0x02,0x02,0x04,0x04,0x00,0x00,0x00,0x00,0x00,0x00,0x00,0x00,//~ 94
};




unsigned char  OLED_GRAM[128][8]; 

void OLED_WRCMD(u8 cmd)  
{  
    u8 i=0;  
    OLED_DC=0;  
    for(i=0;i<8;i++)  
    {  
        OLED_SCL=0;  
        if(cmd&0x80) OLED_SDA=1;  
        else         OLED_SDA=0;  
        OLED_SCL=1;  
        cmd<<=1;  
}  
}  
void OLED_WRDATA(u8 dat)   // 实现写入一字节数据  
{  
    u8 i=0;  
    OLED_DC=1;  
    for(i=0;i<8;i++)  
  {  
        OLED_SCL=0;  
         if(dat&0x80) OLED_SDA=1;  
         else         OLED_SDA=0;  
        OLED_SCL=1;  
        dat<<=1;  
  }    
}  
void OLED_Setxy(u8 x, u8 y)     //OLED 设置坐标  
{   
  OLED_WRCMD(0xb0+y);  
  OLED_WRCMD(((x&0xf0)>>4)|0x10);  
  OLED_WRCMD((x&0x0f)|0x01);   
}   
void OLED_Fill(u8 bmp_dat)   //bmp_dat=0x00全屏灭，bmp_dat=0xff全屏亮  
{  
   u8 y,x;  
   for(y=0;y<8;y++)  
  {  
     OLED_WRCMD(0xb0+y);  
     OLED_WRCMD(0x01);  
     OLED_WRCMD(0x10);  
     for(x=0;x<X_WIDTH;x++)  
        OLED_WRDATA(bmp_dat);  
   }  
}  
void OLED_Init(void) //OLED初始化    
{    
		GPIO_InitTypeDef GPIO_InitStructure;
	GPIO_InitStructure.GPIO_Pin =GPIO_Pin_7| GPIO_Pin_14|GPIO_Pin_15;  	//设置GPIOB0、GPIOB1、GPIOB12
	GPIO_InitStructure.GPIO_Mode = GPIO_Mode_OUT;             //设置选中的引脚工作模为输出模式
  GPIO_InitStructure.GPIO_OType = GPIO_OType_PP;            //设置GPIO的输出方式PP推挽输出
  GPIO_InitStructure.GPIO_Speed = GPIO_Speed_50MHz; ;          //定义GPIO的最高输出频率2MHz
	GPIO_Init(GPIOB , &GPIO_InitStructure);
	GPIO_InitStructure.GPIO_Pin =GPIO_Pin_11;	
		GPIO_Init(GPIOD , &GPIO_InitStructure);
	
   OLED_SCL=1;  
   OLED_RST=0;  
   delay_ms(50);  
     OLED_RST=1;       //从上电到下面开始初始化要有足够的时间，即等待RC复位完毕     
   OLED_WRCMD(0xae);//--关闭显示                                            turn off oled panel  
   OLED_WRCMD(0x00);//---设置低列地址                                    set low column address  
   OLED_WRCMD(0x10);//---高列地址                                        set high column address      
   OLED_WRCMD(0x40);//--设置起始地址映射内存显示开始行（0x 00 ~ 0x3f）   set start line address  Set Mapping RAM Display Start Line (0x00~0x3F)  
   OLED_WRCMD(0x81);//--设置对比度控制寄存器                             set contrast control register  
   OLED_WRCMD(0xcf); // 电流输出亮度设置赛格                             Set SEG Output Current Brightness  
   OLED_WRCMD(0xa1);//--设置赛格/列映射  0xa0左右反置0xa1正常            Set SEG/Column Mapping     0xa0左右反置 0xa1正常  
   OLED_WRCMD(0xc8);//设置网站/行扫描方向 0xc0上下反置 0xc8正常          Set COM/Row Scan Direction     
   OLED_WRCMD(0xa6);//--正常显示                                         set normal display  
  OLED_WRCMD(0xa8);//--集复用率（1 - 64）                               set multiplex ratio(1 to 64)  
  OLED_WRCMD(0x3f);//--1/64 duty  
   OLED_WRCMD(0xd3);//-设置显示偏移位移映射内存计数器（0x 00 ~ 0x3f）    set display offset  Shift Mapping RAM Counter (0x00~0x3F)  
   OLED_WRCMD(0x00);//-不偏移                                            not offset  
   OLED_WRCMD(0xd5);//--设置显示时钟的分频比/振荡器频率                  set display clock divide ratio/oscillator frequency  
 OLED_WRCMD(0x80);//--组分比，时钟设置为100帧/秒                       set divide ratio, Set Clock as 100 Frames/Sec  
   OLED_WRCMD(0xd9);//--设定充电周期                                     set pre-charge period  
  OLED_WRCMD(0xf1);//15集充电放电1钟钟表                                Set Pre-Charge as 15 Clocks & Discharge as 1 Clock  
  OLED_WRCMD(0xda);//--设置组件的引脚配置硬件                           set com pins hardware configuration  
   OLED_WRCMD(0x12);  
 OLED_WRCMD(0xdb);//--集vcomh                                          set vcomh  
   OLED_WRCMD(0x40);//威科姆取消水平集                                   Set VCOM Deselect Level  
  OLED_WRCMD(0x20);//-设置页面寻址模式（0x 00 /将/ 0x02）               Set Page Addressing Mode (0x00/0x01/0x02)  
  OLED_WRCMD(0x02);//  
   OLED_WRCMD(0x8d);//--充电泵启用/禁用                                  set Charge Pump enable/disable  
   OLED_WRCMD(0x14);//--集（0x 10个）禁用                                set(0x10) disable  
   OLED_WRCMD(0xa4);// 使整个显示（0xa4 / 0xa5）                         Disable Entire Display On (0xa4/0xa5)  
  OLED_WRCMD(0xa6);// 禁用反显示（0xa6 / 7）                            Disable Inverse Display On (0xa6/a7)   
  OLED_WRCMD(0xaf);//--打开面板                                         turn on oled panel  
 OLED_Fill(0x00);  //初始清屏  
  OLED_Setxy(0,0);   
}     
void OLED_6x8(u8 x,u8 y,u8 ch[])//显示6*8一组标准ASCII字符串 显示的坐标（x,y），y为页范围0～7  
{  
   u8 c=0,i=0,j=0;        
   while (ch[j]!='\0')  
   {      
     c =ch[j]-32;  
     if(x>126)  
        {x=0;y++;}  
    OLED_Setxy(x,y);      
   for(i=0;i<6;i++)       
      OLED_WRDATA(F6x8[c][i]);    
     x+=6;  
     j++;  
   }  
}  
void OLED_Cler_6x8(u8 x,u8 y,u8 n)//清除N个6*8字符  
{  
   unsigned int i=0;  
   OLED_Setxy(x,y);  
   if(x>126)  
     {x=0;y++;}  
   for(i=0;i<6*n;i++)  
       OLED_WRDATA(0x00);  
}  
void OLED_8x16(u8 x,u8 y,u8 ch[])//显示8*16一组标准ASCII字符串    显示的坐标（x,y），y为页范围0～7  
{  
  unsigned char c=0,i=0,j=0;  
  while (ch[j]!='\0')  
  {      
    c =ch[j]-32;  
    if(x>120)  
      {x=0;y++;}  
    OLED_Setxy(x,y);      
   for(i=0;i<8;i++)       
      OLED_WRDATA(F8X16[c*16+i]);  
    OLED_Setxy(x,y+1);      
    for(i=0;i<8;i++)       
      OLED_WRDATA(F8X16[c*16+i+8]);    
    x+=8;  
    j++;  
  }  
}  
void OLED_Cler_8x16(u8 x,u8 y,u8 n) //清除n个8*16字符  
{  
   unsigned char i;  
   if(x>120)  
    {x=0;y++;}  
  OLED_Setxy(x,y);  
  for(i=0;i<8*n;i++)  
    OLED_WRDATA(0x00);  
   OLED_Setxy(x,y+1);  
   for(i=0;i<8*n;i++)  
     OLED_WRDATA(0x00);      
}  

void Draw_BMP(u8 x0,u8 y0,u8 x1,u8 y1,u8 BMP[])//显示显示BMP图片128×64起始点坐标(x,y),x的范围0～127，y为页的范围0～7*  
{     
 unsigned int j=0;  
 unsigned char x,y;  
   
 if(y1%8==0)  
     y=y1/8;        
  else   
    y=y1/8+1;  
 for(y=y0;y<y1;y++)  
 {  
    OLED_Setxy(x0,y);                
     for(x=x0;x<x1;x++)  
    {        
        OLED_WRDATA(BMP[j++]);            
     }  
  }  
}  
void OLED_Refresh_Gram(void)  
{  
    u8 ii,nn;  
    for(ii=0;ii<8;ii++)  
    {  
        OLED_WRCMD(0xb0+ii);  
        OLED_WRCMD(0x00);  
        OLED_WRCMD(0x10);  
        for(nn=0;nn<120;nn++)OLED_WRDATA(OLED_GRAM[nn][ii]);  
 }  
}  
void OLED_DRAWPoint(u8 x,u8 y,u8 t)  
{  
    u8 pos,bx,temp=0;  
   if(x>127||y>63)return;  
    pos=y/8;  
    bx=y%8;  
    temp=1<<(7-bx);  
    if(t)OLED_GRAM[x][pos]|=temp;  
    else OLED_GRAM[x][pos]&=~temp;  
}  

